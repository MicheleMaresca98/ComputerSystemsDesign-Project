/*
  See https://github.com/SlashDevin/NeoSWSerial for docs about the library.
*/
#include <NeoSWSerial.h>

const uint8_t rx = 4;
const uint8_t tx = 5;
const uint8_t button = 2;
const uint8_t led = 3;
uint8_t data = 7;
uint16_t rcvd_from_st = 0;
uint16_t sent_to_st = 0;
NeoSWSerial st_serial(rx, tx);

static void rcv_from_sw_serial(uint8_t c){
  rcvd_from_st += 1;
  digitalWrite(led, !digitalRead(led));
  Serial.print("Number of messages received: ");
  Serial.print(rcvd_from_st, DEC);
  Serial.println();
}

void setup() {
  Serial.begin(9600);
  pinMode(rx, INPUT);
  pinMode(tx, OUTPUT);
  pinMode(button, INPUT);
  pinMode(led, OUTPUT);
  st_serial.attachInterrupt(rcv_from_sw_serial);
  st_serial.begin(9600);
  while(!Serial){}
  Serial.println("Started");
}

void loop() {
  /*
  if (st_serial.available()) {
    st_serial.read();
    rcvd_from_st += 1;
    digitalWrite(led, !digitalRead(led));
    Serial.print("Number of messages received: ");
    Serial.print(rcvd_from_st, DEC);
    Serial.println();
  }
  */
  if (digitalRead(button) == HIGH){
    while (digitalRead(button) == HIGH){}
    st_serial.write(data);
    sent_to_st += 1;
    Serial.print("Number of messages sent: ");
    Serial.print(sent_to_st, DEC);
    Serial.println();
  }
}
